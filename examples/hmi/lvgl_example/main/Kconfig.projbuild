## examples/hmi/lvgl_example/main/Kconfig.projbuild
```kconfig
menu "Example Configuration"

    choice SELECT_LVGL_DEMO
        bool "Choose LVGL Demo to Run"
            default LV_DEMO_WIDGETS

        config LV_DEMO_BENCHMARK
            bool "LV_DEMO_BENCHMARK-啦"
        config LV_DEMO_PRINTER
            bool "LV_DEMO_PRINTER"
        config LV_DEMO_WIDGETS
            bool "LV_DEMO_WIDGETS"
        config LV_EX_GET_STARTED
            bool "LV_EX_GET_STARTED"
        config LV_DEMO_STRESS
            bool "LV_DEMO_STRESS"
        config LV_EX_STYLE
            bool "LV_EX_STYLE"
    endchoice

endmenu

menu "IR Demo Configuration"
    choice EXAMPLE_IR_PROTOCOL
        prompt "Infrared Protocol"
        default EXAMPLE_IR_PROTOCOL_NEC
        help
            Choose the IR protocol used in the example.

        config EXAMPLE_IR_PROTOCOL_NEC
            bool "NEC"
            help
                NEC is a kind of Pulse Distance Protocol.
                It uses ASK modulation and pulse distance encoding with a carrier frequency of 38 kHz.

        config EXAMPLE_IR_PROTOCOL_RC5
            bool "RC5"
            help
                The RC5 protocol was introduced by Philips.
                It uses ASK modulation and Manchester encoding with carrier frequency fixed at 36 kHz.

    endchoice

    config EXAMPLE_RMT_TX_GPIO
        int "RMT TX GPIO"
        default 18
        help
            Set the GPIO number used for transmitting the RMT signal.

    config EXAMPLE_RMT_RX_GPIO
        int "RMT RX GPIO"
        default 19
        help
            Set the GPIO number used for receiving the RMT signal.
endmenu
```
